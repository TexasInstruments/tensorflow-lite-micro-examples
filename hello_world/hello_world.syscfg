/**
 * @cliArgs --board "/ti/boards/MSP_EXP432P401R" --product "simplelink_msp432p4_sdk@3.40.01.02"
 * @versions {"data":"2020021217","timestamp":"2020021217","tool":"1.4.0+1234","templates":"2020021217"}
 */

/**
 * Import the modules used in this configuration.
 */
const Display  = scripting.addModule("/ti/display/Display", {}, false);
const Display1 = Display.addInstance();

/**
 * Write custom configuration values to the imported modules.
 */
Display1.$name           = "CONFIG_Display_0";
Display1.$hardware       = system.deviceData.board.components.XDS110UART;
Display1.uart.$name      = "CONFIG_UART_0";
Display1.uart.uart.$name = "MyUART1";

const Power                   = scripting.addModule("/ti/drivers/Power", {}, false);
Power.performanceLevel3.$name = "ti_drivers_power_PowerMSP432PerfLevels0";
Power.performanceLevel2.$name = "ti_drivers_power_PowerMSP432PerfLevels1";
Power.performanceLevel1.$name = "ti_drivers_power_PowerMSP432PerfLevels2";
Power.performanceLevel0.$name = "ti_drivers_power_PowerMSP432PerfLevels3";

RTOS.name                  = "NoRTOS";
RTOS.timer0.resource.$name = "MyTIMER_A1";

/**
 * Pinmux solution for unlocked pins/peripherals. This ensures that minor changes to the automatic solver in a future
 * version of the tool will not impact the pinmux you originally saw.  These lines can be completely deleted in order to
 * re-solve from scratch.
 */
Display1.uart.uart.$suggestSolution             = "EUSCI_A0";
Display1.uart.uart.txPin.$suggestSolution       = "7";
Display1.uart.uart.rxPin.$suggestSolution       = "6";
GPIO1.gpioPin.$suggestSolution                  = "4";
RTOS.timer0.resource.$suggestSolution           = "Timer_A0";
