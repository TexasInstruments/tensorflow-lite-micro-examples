/**
 * @cliArgs --board "/ti/boards/CC3235SF_LAUNCHXL" --product "simplelink_cc32xx_sdk@4.30.00.02_eng"
 * @versions {"data":"2021040816","timestamp":"2021040816","tool":"1.8.1+1900","templates":null}
 */

/**
 * Import the modules used in this configuration.
 */
const Display  = scripting.addModule("/ti/display/Display", {}, false);
const Display1 = Display.addInstance();
const GPIO     = scripting.addModule("/ti/drivers/GPIO");
const GPIO1    = GPIO.addInstance();
const RTOS     = scripting.addModule("/ti/drivers/RTOS");

/**
 * Write custom configuration values to the imported modules.
 */
Display1.$name      = "CONFIG_Display_0";
Display1.$hardware  = system.deviceData.board.components.XDS110UART;
Display1.uart.$name = "CONFIG_UART_0";

GPIO1.$hardware = system.deviceData.board.components.LED_BLUE;
GPIO1.$name     = "CONFIG_GPIO_LED_0";

const Power          = scripting.addModule("/ti/drivers/Power", {}, false);
Power.parkPins.$name = "ti_drivers_power_PowerCC32XXPins0";

RTOS.name = "NoRTOS";

/**
 * Pinmux solution for unlocked pins/peripherals. This ensures that minor changes to the automatic solver in a future
 * version of the tool will not impact the pinmux you originally saw.  These lines can be completely deleted in order to
 * re-solve from scratch.
 */
Display1.uart.uart.$suggestSolution       = "UART0";
Display1.uart.uart.txPin.$suggestSolution = "55";
Display1.uart.uart.rxPin.$suggestSolution = "57";
GPIO1.gpioPin.$suggestSolution            = "boosterpack.29";
